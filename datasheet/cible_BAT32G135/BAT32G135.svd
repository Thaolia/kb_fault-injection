# BAT32G135 register map
Vendor: CMS; Series: BAT32G135; File version: 1.2
CPU: CM0+ r0p1, little endian, no MPU, no FPU, VTOR, 2 interrupt priority bits
Registers are 8-bit, read-write, reset 0x0 unless marked. A register's access mark holds for its fields unless they carry their own. Offsets are from the block's base; [hi:lo] are bit positions; {n}, {i} and the like mark numbered series; 'fields as' and 'values as' point back to an identical list.

## PORT — Port functions
Base 0x40040000
0x00 P0 (reset mask 0x3) — Port register 0
0x01 P1 — Port register 1
0x02 P2 — Port register 2
{0x0+i} P{i} (reset mask 0x3) (i=3..5) — Port register {i}
0x06 P6 (reset mask 0xF) — Port register 6
0x07 P7 (reset mask 0x3F) — Port register 7
0x0C P12 (reset mask 0x1F) — Port register 12
0x0D P13 (reset mask 0xC1) — Port register 13
0x0E P14 (reset mask 0xC1) — Port register 14
0x10 PSET0 (reset mask 0x3) — Port set register 0
0x11 PSET1 — Port set register 1
0x12 PSET2 — Port set register 2
{0x10+i} PSET{i} (reset mask 0x3) (i=3..5) — Port set register {i}
0x16 PSET6 (reset mask 0xF) — Port set register 6
0x17 PSET7 (reset mask 0x3F) — Port set register 7
0x1C PSET12 (reset mask 0x1F) — Port set register 12
0x1D PSET13 (reset mask 0xC1) — Port set register 13
0x1E PSET14 (reset mask 0xC1) — Port set register 14
0x20 PM0 reset 0xFF (reset mask 0x3) — Port mode register 0
0x21 PM1 reset 0xFF — Port mode register 1
0x22 PM2 reset 0xFF — Port mode register 2
{0x20+i} PM{i} reset 0xFF (reset mask 0x3) (i=3..5) — Port mode register {i}
0x26 PM6 reset 0xFF (reset mask 0xF) — Port mode register 6
0x27 PM7 reset 0xFF (reset mask 0x3F) — Port mode register 7
0x2C PM12 reset 0xFF (reset mask 0x1F) — Port mode register 12
0x2D PM13 reset 0xFE (reset mask 0xC1) — Port mode register 13
0x2E PM14 reset 0xFF (reset mask 0xC1) — Port mode register 14
0x30 PU0 (reset mask 0x3) — Pull-up resistor option register 0
0x31 PU1 reset 0x1 — Pull-up resistor option register 1
0x32 PU2 reset 0x40 — Pull-up resistor option register 2
0x33 PU3 (reset mask 0x3) — Pull-up resistor option register 3
0x34 PU4 reset 0x1 (reset mask 0x3) — Pull-up resistor option register 4
0x35 PU5 (reset mask 0x3) — Pull-up resistor option register 5
0x36 PU6 (reset mask 0xC) — Pull-up resistor option register 6
0x37 PU7 (reset mask 0x3F) — Pull-up resistor option register 7
0x3C PU12 (reset mask 0x1) — Pull-up resistor option register 12
0x3D PU13 reset 0x80 (reset mask 0xC1) — Pull-up resistor option register 13
0x3E PU14 (reset mask 0xC1) — Pull-up resistor option register 14
0x40 PD0 (reset mask 0x3) — Pull-down resistor option register 0
0x41 PD1 — Pull-down resistor option register 1
0x42 PD2 — Pull-down resistor option register 2
0x43 PD3 (reset mask 0x3) — Pull-down resistor option register 3
0x45 PD5 (reset mask 0x3) — Pull-down resistor option register 5
0x46 PD6 (reset mask 0xC) — Pull-down resistor option register 6
0x47 PD7 (reset mask 0x3F) — Pull-down resistor option register 7
0x4C PD12 (reset mask 0x1) — Pull-down resistor option register 12
0x4D PD13 (reset mask 0x41) — Pull-down resistor option register 13
0x4E PD14 (reset mask 0xC1) — Pull-down resistor option register 14
0x50 POM0 (reset mask 0x3) — Port output mode register 0
0x51 POM1 — Port output mode register 1
0x52 POM2 — Port output mode register 2
{0x50+i} POM{i} (reset mask 0x3) (i=3..5) — Port output mode register {i}
0x56 POM6 (reset mask 0xC) — Port output mode register 6
0x57 POM7 (reset mask 0x3F) — Port output mode register 7
0x5C POM12 (reset mask 0x1) — Port output mode register 12
0x5D POM13 (reset mask 0xC1) — Port output mode register 13
0x5E POM14 (reset mask 0xC1) — Port output mode register 14
0x60 PMC0 reset 0xFF (reset mask 0x3) — Port mode control register 0
0x61 PMC1 reset 0xFE — Port mode control register 1
0x62 PMC2 reset 0xDF — Port mode control register 2
0x63 PMC3 reset 0xFF (reset mask 0x3) — Port mode control register 3
0x65 PMC5 reset 0xFF (reset mask 0x3) — Port mode control register 5
0x66 PMC6 reset 0xFF (reset mask 0xC) — Port mode control register 6
0x67 PMC7 reset 0xFF (reset mask 0x3F) — Port mode control register 7
0x6C PMC12 reset 0xFF (reset mask 0x1) — Port mode control register 12
0x6D PMC13 reset 0x7E (reset mask 0x41) — Port mode control register 13
0x6E PMC14 reset 0xFF (reset mask 0xC1) — Port mode control register 14
0x70 PCLR0 (reset mask 0x3) — Port clear register 0
0x71 PCLR1 — Port clear register 1
0x72 PCLR2 — Port clear register 2
{0x70+i} PCLR{i} (reset mask 0x3) (i=3..5) — Port clear register {i}
0x76 PCLR6 (reset mask 0xF) — Port clear register 6
0x77 PCLR7 (reset mask 0x3F) — Port clear register 7
0x7C PCLR12 (reset mask 0x1F) — Port clear register 12
0x7D PCLR13 (reset mask 0xC1) — Port clear register 13
0x7E PCLR14 (reset mask 0xC1) — Port clear register 14
0x800 P00CFG — Alterate Output Function configuration register
  [3:0] CFG
    0=GPIO (Port used as GPIO); {v}=TO{v+9} (Port used as TO{v+9}) (v=1..4); 5=SDO00/TxD0 (Port used as SDO00/TxD0); 6=SDO20/TxD2 (Port used as SDO20/TxD2); 7=CLKBUZ0 (Port used as CLKBUZ0); 8=SCLKO00 (Port used as SCLK00 output); 9=SCLKO20 (Port used as SCLK20 output); 10=TXD1 (Port used as TXD1)
0x801 P01CFG — Alterate Output Function configuration register
  fields as P00CFG
{0x7FE+i} P{i}CFG (i=10..17) — Alterate Output Function configuration register
  fields as P00CFG
{0x7FC+i} P{i}CFG (i=20..27) — Alterate Output Function configuration register
  fields as P00CFG
0x818 P30CFG — Alterate Output Function configuration register
  fields as P00CFG
0x819 P31CFG — Alterate Output Function configuration register
  fields as P00CFG
0x820 P40CFG — Alterate Output Function configuration register
  fields as P00CFG
0x821 P41CFG — Alterate Output Function configuration register
  fields as P00CFG
0x828 P50CFG — Alterate Output Function configuration register
  fields as P00CFG
0x829 P51CFG — Alterate Output Function configuration register
  fields as P00CFG
{0x7F4+i} P{i}CFG (i=60..63) — Alterate Output Function configuration register
  fields as P00CFG
{0x7F2+i} P{i}CFG (i=70..75) — Alterate Output Function configuration register
  fields as P00CFG
{0x7C8+i} P{i}CFG (i=120..124) — Alterate Output Function configuration register
  fields as P00CFG
0x848 P130CFG — Alterate Output Function configuration register
  fields as P00CFG
0x84E P136CFG — Alterate Output Function configuration register
  fields as P00CFG
0x84F P137CFG — Alterate Output Function configuration register
  fields as P00CFG
0x850 P140CFG — Alterate Output Function configuration register
  fields as P00CFG
0x856 P146CFG — Alterate Output Function configuration register
  fields as P00CFG
0x857 P147CFG — Alterate Output Function configuration register
  fields as P00CFG
{0x856+i} TI{i}PCFG (i=10..13) — TI{i} alternate function pin configuration register
  [5:0] CFG
    1=P00 (P00 used as TI{i}); 2=P01 (P01 used as TI{i}); {v}=P{v+7} (P{v+7} used as TI{i}) (v=3..10); {v}=P{v+9} (P{v+9} used as TI{i}) (v=11..18); 19=P30 (P30 used as TI{i}); 20=P31 (P31 used as TI{i}); 21=P40 (P40 used as TI{i}); 22=P41 (P41 used as TI{i}); 23=P50 (P50 used as TI{i}); 24=P51 (P51 used as TI{i}); {v}=P{v+35} (P{v+35} used as TI{i}) (v=25..28); {v}=P{v+41} (P{v+41} used as TI{i}) (v=29..34); {v}=P{v+85} (P{v+85} used as TI{i}) (v=35..39); 40=P130 (P130 used as TI{i}); 41=P136 (P136 used as TI{i}); 42=P137 (P137 used as TI{i}); 43=P140 (P140 used as TI{i}); 44=P146 (P146 used as TI{i}); 45=P147 (P147 used as TI{i})
{0x864+i} INTP{i}PCFG (i=0..3) — INTP{i} alternate function pin configuration register
  [5:0] CFG
    1=P00 (P00 used as INTP{i}); 2=P01 (P01 used as INTP{i}); {v}=P{v+7} (P{v+7} used as INTP{i}) (v=3..10); {v}=P{v+9} (P{v+9} used as INTP{i}) (v=11..18); 19=P30 (P30 used as INTP{i}); 20=P31 (P31 used as INTP{i}); 21=P40 (P40 used as INTP{i}); 22=P41 (P41 used as INTP{i}); 23=P50 (P50 used as INTP{i}); 24=P51 (P51 used as INTP{i}); {v}=P{v+35} (P{v+35} used as INTP{i}) (v=25..28); {v}=P{v+41} (P{v+41} used as INTP{i}) (v=29..34); {v}=P{v+85} (P{v+85} used as INTP{i}) (v=35..39); 40=P130 (P130 used as INTP{i}); 41=P136 (P136 used as INTP{i}); 42=P137 (P137 used as INTP{i}); 43=P140 (P140 used as INTP{i}); 44=P146 (P146 used as INTP{i}); 45=P147 (P147 used as INTP{i})
0x868 SDI00PCFG — SDI00/RXD0/SDA00 alternate function pin configuration register
  [5:0] CFG
    1=P00 (P00 used as SDI00/RXD0/SDA00); 2=P01 (P01 used as SDI00/RXD0/SDA00); {v}=P{v+7} (P{v+7} used as SDI00/RXD0/SDA00) (v=3..10); {v}=P{v+9} (P{v+9} used as SDI00/RXD0/SDA00) (v=11..18); 19=P30 (P30 used as SDI00/RXD0/SDA00); 20=P31 (P31 used as SDI00/RXD0/SDA00); 21=P40 (P40 used as SDI00/RXD0/SDA00); 22=P41 (P41 used as SDI00/RXD0/SDA00); 23=P50 (P50 used as SDI00/RXD0/SDA00); 24=P51 (P51 used as SDI00/RXD0/SDA00); {v}=P{v+35} (P{v+35} used as SDI00/RXD0/SDA00) (v=25..28); {v}=P{v+41} (P{v+41} used as SDI00/RXD0/SDA00) (v=29..34); {v}=P{v+85} (P{v+85} used as SDI00/RXD0/SDA00) (v=35..39); 40=P130 (P130 used as SDI00/RXD0/SDA00); 41=P136 (P136 used as SDI00/RXD0/SDA00); 42=P137 (P137 used as SDI00/RXD0/SDA00); 43=P140 (P140 used as SDI00/RXD0/SDA00); 44=P146 (P146 used as SDI00/RXD0/SDA00); 45=P147 (P147 used as SDI00/RXD0/SDA00)
0x868 SDA00PCFG (alternate view of SDI00PCFG) — SDI00/RXD0/SDA00 alternate function pin configuration register
0x868 RXD0PCFG (alternate view of SDI00PCFG) — SDI00/RXD0/SDA00 alternate function pin configuration register
0x869 SCLKI00PCFG — SCLKI00 alternate function pin configuration register
  [5:0] CFG
    1=P00 (P00 used as SCLKI00); 2=P01 (P01 used as SCLKI00); {v}=P{v+7} (P{v+7} used as SCLKI00) (v=3..10); {v}=P{v+9} (P{v+9} used as SCLKI00) (v=11..18); 19=P30 (P30 used as SCLKI00); 20=P31 (P31 used as SCLKI00); 21=P40 (P40 used as SCLKI00); 22=P41 (P41 used as SCLKI00); 23=P50 (P50 used as SCLKI00); 24=P51 (P51 used as SCLKI00); {v}=P{v+35} (P{v+35} used as SCLKI00) (v=25..28); {v}=P{v+41} (P{v+41} used as SCLKI00) (v=29..34); {v}=P{v+85} (P{v+85} used as SCLKI00) (v=35..39); 40=P130 (P130 used as SCLKI00); 41=P136 (P136 used as SCLKI00); 42=P137 (P137 used as SCLKI00); 43=P140 (P140 used as SCLKI00); 44=P146 (P146 used as SCLKI00); 45=P147 (P147 used as SCLKI00)
0x86A SS00PCFG — SS00 alternate function pin configuration register
  [5:0] CFG
    1=P00 (P00 used as SS00); 2=P01 (P01 used as SS00); {v}=P{v+7} (P{v+7} used as SS00) (v=3..10); {v}=P{v+9} (P{v+9} used as SS00) (v=11..18); 19=P30 (P30 used as SS00); 20=P31 (P31 used as SS00); 21=P40 (P40 used as SS00); 22=P41 (P41 used as SS00); 23=P50 (P50 used as SS00); 24=P51 (P51 used as SS00); {v}=P{v+35} (P{v+35} used as SS00) (v=25..28); {v}=P{v+41} (P{v+41} used as SS00) (v=29..34); {v}=P{v+85} (P{v+85} used as SS00) (v=35..39); 40=P130 (P130 used as SS00); 41=P136 (P136 used as SS00); 42=P137 (P137 used as SS00); 43=P140 (P140 used as SS00); 44=P146 (P146 used as SS00); 45=P147 (P147 used as SS00)
0x86B SDI20PCFG — SDI20/RXD2/IrRXD alternate function pin configuration register
  [5:0] CFG
    1=P00 (P00 used as SDI20/RXD2/IrRXD); 2=P01 (P01 used as SDI20/RXD2/IrRXD); {v}=P{v+7} (P{v+7} used as SDI20/RXD2/IrRXD) (v=3..10); {v}=P{v+9} (P{v+9} used as SDI20/RXD2/IrRXD) (v=11..18); 19=P30 (P30 used as SDI20/RXD2/IrRXD); 20=P31 (P31 used as SDI20/RXD2/IrRXD); 21=P40 (P40 used as SDI20/RXD2/IrRXD); 22=P41 (P41 used as SDI20/RXD2/IrRXD); 23=P50 (P50 used as SDI20/RXD2/IrRXD); 24=P51 (P51 used as SDI20/RXD2/IrRXD); {v}=P{v+35} (P{v+35} used as SDI20/RXD2/IrRXD) (v=25..28); {v}=P{v+41} (P{v+41} used as SDI20/RXD2/IrRXD) (v=29..34); {v}=P{v+85} (P{v+85} used as SDI20/RXD2/IrRXD) (v=35..39); 40=P130 (P130 used as SDI20/RXD2/IrRXD); 41=P136 (P136 used as SDI20/RXD2/IrRXD); 42=P137 (P137 used as SDI20/RXD2/IrRXD); 43=P140 (P140 used as SDI20/RXD2/IrRXD); 44=P146 (P146 used as SDI20/RXD2/IrRXD); 45=P147 (P147 used as SDI20/RXD2/IrRXD)
0x86B IRRXDPCFG (alternate view of SDI20PCFG) — SDI20/RXD2/IrRXD alternate function pin configuration register
0x86B RXD2PCFG (alternate view of SDI20PCFG) — SDI20/RXD2/IrRXD alternate function pin configuration register
0x86C SCLKI20PCFG — SCLKI20 alternate function pin configuration register
  [5:0] CFG
    1=P00 (P00 used as SCLKI20); 2=P01 (P01 used as SCLKI20); {v}=P{v+7} (P{v+7} used as SCLKI20) (v=3..10); {v}=P{v+9} (P{v+9} used as SCLKI20) (v=11..18); 19=P30 (P30 used as SCLKI20); 20=P31 (P31 used as SCLKI20); 21=P40 (P40 used as SCLKI20); 22=P41 (P41 used as SCLKI20); 23=P50 (P50 used as SCLKI20); 24=P51 (P51 used as SCLKI20); {v}=P{v+35} (P{v+35} used as SCLKI20) (v=25..28); {v}=P{v+41} (P{v+41} used as SCLKI20) (v=29..34); {v}=P{v+85} (P{v+85} used as SCLKI20) (v=35..39); 40=P130 (P130 used as SCLKI20); 41=P136 (P136 used as SCLKI20); 42=P137 (P137 used as SCLKI20); 43=P140 (P140 used as SCLKI20); 44=P146 (P146 used as SCLKI20); 45=P147 (P147 used as SCLKI20)
0x86D SDAA0PCFG — SDAA0 alternate function pin configuration register
  [5:0] CFG
    1=P00 (P00 used as SDAA0); 2=P01 (P01 used as SDAA0); {v}=P{v+7} (P{v+7} used as SDAA0) (v=3..10); {v}=P{v+9} (P{v+9} used as SDAA0) (v=11..18); 19=P30 (P30 used as SDAA0); 20=P31 (P31 used as SDAA0); 21=P40 (P40 used as SDAA0); 22=P41 (P41 used as SDAA0); 23=P50 (P50 used as SDAA0); 24=P51 (P51 used as SDAA0); {v}=P{v+35} (P{v+35} used as SDAA0) (v=25..28); {v}=P{v+41} (P{v+41} used as SDAA0) (v=29..34); {v}=P{v+85} (P{v+85} used as SDAA0) (v=35..39); 40=P130 (P130 used as SDAA0); 41=P136 (P136 used as SDAA0); 42=P137 (P137 used as SDAA0); 43=P140 (P140 used as SDAA0); 44=P146 (P146 used as SDAA0); 45=P147 (P147 used as SDAA0)
0x86E SCLA0PCFG — SCLA0 alternate function pin configuration register
  [5:0] CFG
    1=P00 (P00 used as SCLA0); 2=P01 (P01 used as SCLA0); {v}=P{v+7} (P{v+7} used as SCLA0) (v=3..10); {v}=P{v+9} (P{v+9} used as SCLA0) (v=11..18); 19=P30 (P30 used as SCLA0); 20=P31 (P31 used as SCLA0); 21=P40 (P40 used as SCLA0); 22=P41 (P41 used as SCLA0); 23=P50 (P50 used as SCLA0); 24=P51 (P51 used as SCLA0); {v}=P{v+35} (P{v+35} used as SCLA0) (v=25..28); {v}=P{v+41} (P{v+41} used as SCLA0) (v=29..34); {v}=P{v+85} (P{v+85} used as SCLA0) (v=35..39); 40=P130 (P130 used as SCLA0); 41=P136 (P136 used as SCLA0); 42=P137 (P137 used as SCLA0); 43=P140 (P140 used as SCLA0); 44=P146 (P146 used as SCLA0); 45=P147 (P147 used as SCLA0)
0x86F RXD1PCFG — RXD1 alternate function pin configuration register
  [5:0] CFG
    1=P00 (P00 used as RXD1); 2=P01 (P01 used as RXD1); {v}=P{v+7} (P{v+7} used as RXD1) (v=3..10); {v}=P{v+9} (P{v+9} used as RXD1) (v=11..18); 19=P30 (P30 used as RXD1); 20=P31 (P31 used as RXD1); 21=P40 (P40 used as RXD1); 22=P41 (P41 used as RXD1); 23=P50 (P50 used as RXD1); 24=P51 (P51 used as RXD1); {v}=P{v+35} (P{v+35} used as RXD1) (v=25..28); {v}=P{v+41} (P{v+41} used as RXD1) (v=29..34); {v}=P{v+85} (P{v+85} used as RXD1) (v=35..39); 40=P130 (P130 used as RXD1); 41=P136 (P136 used as RXD1); 42=P137 (P137 used as RXD1); 43=P140 (P140 used as RXD1); 44=P146 (P146 used as RXD1); 45=P147 (P147 used as RXD1)
0x86F SDA10PCFG (alternate view of RXD1PCFG) — SDA10 alternate function pin configuration register
0x86F SDI10PCFG (alternate view of RXD1PCFG) — SDI10 alternate function pin configuration register
0x87B PMS (reset mask 0x1) — Port mode select register
0x87E SPIPCFG (reset mask 0x1) — SPI alternate function pins configuration register
