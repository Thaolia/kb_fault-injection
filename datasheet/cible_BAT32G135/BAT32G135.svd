# BAT32G135 register map
Vendor: CMS; Series: BAT32G135; File version: 1.2
ARM 32-bit Cortex-M0+ Microcontroller based device, CPU clock up to 48MHz, etc.
CPU: CM0+ r0p1, little endian, no MPU, no FPU, VTOR, 2 interrupt priority bits
Registers are 8-bit, read-write, reset 0x0 unless marked. A register's access mark holds for its fields unless they carry their own. Offsets are from the block's base; lines under a group give offsets from that group; [hi:lo] are bit positions; {n}, {i} and the like mark numbered series; 'fields as' and 'values as' point back to an identical list; <NAME> marks a mode.

## Memory map
0x00500660 BGR size 0x8 — Temperature Sensor calibration data
0x00500668 TSN size 0x8 — Temperature Sensor calibration data
0x0050084C UID size 0x80 — 128-bit Unique ID
0x20000000 DMAVEC size 0x2C0 — DMA Vector and Control Data Area
0x40005000 DMA size 0x100 — Enhanced DMA Controller
0x40006000 INT size 0x200 — Interrupt Controller
0x4001B000 DBG size 0x100 — DBG Controller
0x40020000 FMC size 0x400 — Flash Memory Controller
0x40020100 SAF size 0x30000 — Flash memory CRC operation function (High-Speed CRC)
0x40020400 CGC size 0x2000 — Clock Generate Control
0x40020404 WDT size 0xC00 — Watchdog Timer with window
0x40020420 RST size 0x40 — Reset Function
0x40020440 LVD size 0x100 — Voltage detector
0x40040000 PORT size 0x1000 — Port functions
0x40040470 MISC size 0x100 — Miscellaneous function
0x40040FA0 PCBZ size 0x10 — Clock/Buzzer output controller
0x40041100 SCI0 size 0x300 — Serial Communication Interface 0 with UART, SPI and simplified I2C supported
0x40041540 SCI1 size 0x300 — Serial Communication Interface 1 with UART, SPI and simplified I2C supported
0x40041A30 IICA size 0x200 — Serial Interface I2C with multimaster and wakeup supported
0x40041D80 TM40 size 0x200 — General Purpose Timer 4
0x40042180 TM41 size 0x200 — General Purpose Timer 4
0x40042400 SPI size 0x200 — Serial Interface SPI
0x400432F0 CRC size 0x100 — General Purpose CRC
0x40043400 ELC size 0x100 — Event Link Controller
0x40043840 CMP size 0x100 — Comparator
0x40043840 PGA size 0x100 — Programmable Gain Amplifier
0x400440A0 IRDA size 0x1 — IrDA communication module based on Infrared Data Association stardard 1.0
0x40044400 EPWM size 0x100 — Enhance PWM controller
0x40044B30 KEY size 0x10 — Key interrupt
0x40044F00 RTC size 0x100 — Real-Time clock
0x40045000 ADC size 0x100 — A/D Converter
0x40045B38 INTM size 0x100 — Pin input edge detection

## Interrupts
0 LVI (CGC, LVD) — Low Voltage detection interrupt
1 INTP0 (INTM) — INTP0 External interrupt request input is valid
2 INTP1 (INTM) — INTP1 External interrupt request input is valid
3 INTP2 (INTM) — INTP2 External interrupt request input is valid
4 INTP3 (INTM) — INTP3 External interrupt request input is valid
5 TM01H (TM40) — TM40 channel 1(higher 8 bit) interrupt request
6 KEY — KEY return interrupt request
7 ST2 (SCI1) — UART2 transmission transfer end or buffer empty
8 SR2 (SCI1) — UART2 rerception transfer
9 SRE2 (SCI1) — UART2 rerception communication error occurrence
10 ST0 (SCI0) — UART0 transmission transfer end or buffer empty
11 SR0 (SCI0) — UART0 rerception transfer
12 SRE0 (SCI0) — UART0 rerception communication error occurrence
13 ST1 (SCI0) — UART1 transmission transfer end or buffer empty
14 SR1 (SCI0) — UART1 rerception transfer
15 SRE1 (SCI0) — UART1 rerception communication error occurrence
16 IICA — IICA interrupt request
17 TM00 (TM40) — TM40 channel 0 interrupt request
18 TM01 (TM40) — TM40 channel 1 interrupt request
19 TM02 (TM40) — TM40 channel 2 interrupt request
20 TM03 (TM40) — TM40 channel 3 interrupt request
21 ADC — ADC interrupt request
22 RTC — Real-Time Clock interrupt request
23 IT (RTC) — 15-bit interval timer interrupt request
24 CMP0 (CMP) — CMP0 interrupt request
25 CMP1 (CMP) — CMP1 interrupt request
27 TM10 (TM41) — TM41 channel 0 interrupt request
28 TM11 (TM41) — TM41 channel 1 interrupt request
29 TM12 (TM41) — TM41 channel 2 interrupt request
30 TM13 (TM41) — TM41 channel 3 interrupt request
31 FMC — Flash erase or write finish

## Licence text in the file
ARM Limited (ARM) is supplying this software for use with Cortex-M processor based microcontroller, but can be equally used for other suitable processor architectures. This file can be freely distributed. Modifications to this file shall be clearly marked. . THIS SOFTWARE IS PROVIDED "AS IS". NO WARRANTIES, WHETHER EXPRESS, IMPLIED. OR STATUTORY, INCLUDING, BUT NOT LIMITED TO, IMPLIED WARRANTIES OF. MERCHANTABILITY AND FITNESS FOR A PARTICULAR PURPOSE APPLY TO THIS SOFTWARE. ARM SHALL NOT, IN ANY CIRCUMSTANCES, BE LIABLE FOR SPECIAL, INCIDENTAL, OR. CONSEQUENTIAL DAMAGES, FOR ANY REASON WHATSOEVER.

## Notices in the file
Copyright (C) 2012-2014 ARM Limited. All rights reserved.
Purpose: System Viewer Description (SVD) Example (Schema Version 1.1)
This is a description of a none-existent and incomplete device
for demonstration purposes only.
Redistribution and use in source and binary forms, with or without
modification, are permitted provided that the following conditions are met:
- Redistributions of source code must retain the above copyright
notice, this list of conditions and the following disclaimer.
- Redistributions in binary form must reproduce the above copyright
notice, this list of conditions and the following disclaimer in the
documentation and/or other materials provided with the distribution.
- Neither the name of ARM nor the names of its contributors may be used
to endorse or promote products derived from this software without
specific prior written permission.
THIS SOFTWARE IS PROVIDED BY THE COPYRIGHT HOLDERS AND CONTRIBUTORS "AS IS"
AND ANY EXPRESS OR IMPLIED WARRANTIES, INCLUDING, BUT NOT LIMITED TO, THE
ARE DISCLAIMED. IN NO EVENT SHALL COPYRIGHT HOLDERS AND CONTRIBUTORS BE
LIABLE FOR ANY DIRECT, INDIRECT, INCIDENTAL, SPECIAL, EXEMPLARY, OR
CONSEQUENTIAL DAMAGES (INCLUDING, BUT NOT LIMITED TO, PROCUREMENT OF
SUBSTITUTE GOODS OR SERVICES; LOSS OF USE, DATA, OR PROFITS; OR BUSINESS
INTERRUPTION) HOWEVER CAUSED AND ON ANY THEORY OF LIABILITY, WHETHER IN
CONTRACT, STRICT LIABILITY, OR TORT (INCLUDING NEGLIGENCE OR OTHERWISE)
ARISING IN ANY WAY OUT OF THE USE OF THIS SOFTWARE, EVEN IF ADVISED OF THE
POSSIBILITY OF SUCH DAMAGE.
